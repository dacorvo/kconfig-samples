## Kconfig
```kconfig
mainmenu "Sample configurable project using Kconfig"

source "src/Kconfig"

config EXTERNAL_SERVICES
    string
    option env="EXTERNAL_SERVICES"

config EXT_SVC_PATH
    string
    depends on EXTERNAL_SERVICES != "external/none"
    default EXTERNAL_SERVICES

source "$EXTERNAL_SERVICES/Kconfig"
```

## bar/Kconfig
```kconfig
config BAR
    bool "Bar module"
    select FOO
    help
        The notorious Bar module
```

## external/sample/Kconfig
```kconfig
config EXT1
    bool "First external module"
    select FOO

config EXT2
    bool "Second external module"
    depends on BAR
    depends on EXT1
```

## src/baz/Kconfig
```kconfig
config BAZ
    bool "Baz module"
    depends on BAR
    help
        The popular Baz module

comment "The Baz module requires the Bar module"
    depends on !BAR

if BAZ

source src/baz/qux/Kconfig

endif
```
